## arch/arm64/configs/defconfig
```kconfig
#  Default ZTE
# General setup
#
CONFIG_SYSVIPC=y
CONFIG_POSIX_MQUEUE=y
CONFIG_AUDIT=y
CONFIG_NO_HZ_IDLE=y
# CONFIG_NO_HZ_FULL is not set

CONFIG_HIGH_RES_TIMERS=y
CONFIG_BSD_PROCESS_ACCT=y
CONFIG_BSD_PROCESS_ACCT_V3=y
CONFIG_IKCONFIG=y
CONFIG_IKCONFIG_PROC=y
CONFIG_RESOURCE_COUNTERS=y
CONFIG_MEMCG=y
CONFIG_MEMCG_SWAP=y
CONFIG_MEMCG_KMEM=y
CONFIG_CGROUP_HUGETLB=y

#
# RCU Subsystem
#
# CONFIG_UTS_NS is not set
# CONFIG_IPC_NS is not set
# CONFIG_PID_NS is not set
CONFIG_NET_NS=y
# CONFIG_NET_NS is not set
CONFIG_SCHED_AUTOGROUP=y
# CONFIG_SCHED_AUTOGROUP is not set
CONFIG_BLK_DEV_INITRD=y
CONFIG_KALLSYMS_ALL=y
# CONFIG_KALLSYMS_ALL is not set

#
# Kernel Performance Events And Counters
#
CONFIG_PROFILING=y
CONFIG_JUMP_LABEL=y
# CONFIG_JUMP_LABEL is not set

#
# GCOV-based kernel profiling
#
CONFIG_MODULES=y
CONFIG_MODULE_UNLOAD=y

#
# IO Schedulers
#
# CONFIG_BLK_DEV_BSG is not set
# CONFIG_IOSCHED_DEADLINE is not set

#
# Platform selection
#
# CONFIG_ARCH_THUNDER is not set
# CONFIG_ARCH_VEXPRESS is not set
# CONFIG_ARCH_XGENE is not set
CONFIG_BOARD_AILSA_II=y

#
# Bus support
#
CONFIG_PCI=y
CONFIG_PCI_MSI=y

#
# PCI host controller drivers
#
# CONFIG_PCI_HOST_GENERIC is not set
CONFIG_PCI_XGENE=y

#
# ARM errata workarounds via the alternatives framework
#
CONFIG_SMP=y
CONFIG_PREEMPT=y
# CONFIG_KSM is not set
CONFIG_TRANSPARENT_HUGEPAGE=y
CONFIG_CMA=y

#
# Boot options
#
CONFIG_CMDLINE="console=ttyAMA0"

#
# Userspace binary formats
#
# CONFIG_CORE_DUMP_DEFAULT_ELF_HEADERS is not set
CONFIG_COMPAT=y

#
# ARM CPU frequency scaling drivers
#
CONFIG_NET=y

#
# Networking options
#
CONFIG_PACKET=y
CONFIG_UNIX=y
CONFIG_INET=y
CONFIG_IP_PNP=y
CONFIG_IP_PNP_DHCP=y
# CONFIG_IP_PNP_BOOTP is not set
# CONFIG_INET_LRO is not set
CONFIG_IPV6=y

#
# Classification
#
CONFIG_BPF_JIT=y
# CONFIG_BPF_JIT is not set

#
# Bluetooth device drivers
#
CONFIG_WIRELESS=y
# CONFIG_WIRELESS is not set

#
# Generic Driver Options
#
CONFIG_UEVENT_HELPER=y
CONFIG_UEVENT_HELPER_PATH="/sbin/hotplug"
CONFIG_DEVTMPFS=y
CONFIG_DEVTMPFS_MOUNT=y
# CONFIG_DEVTMPFS is not set
CONFIG_DMA_CMA=y

#
# Device Tree and Open Firmware support
#
CONFIG_BLK_DEV_LOOP=y
CONFIG_VIRTIO_BLK=y
CONFIG_NET_9P=y
CONFIG_NET_9P_VIRTIO=y
CONFIG_VIRTIO_NET=y

#
# SCSI support type (disk, tape, CD-ROM)
#
CONFIG_BLK_DEV_SD=y
CONFIG_SATA_AHCI=y
CONFIG_SATA_AHCI_PLATFORM=y
CONFIG_AHCI_XGENE=y
CONFIG_PATA_PLATFORM=y
CONFIG_PATA_OF_PLATFORM=y

#
# SCSI Transports
#
CONFIG_SCSI_LOWLEVEL=y
# CONFIG_SCSI_LOWLEVEL is not set
CONFIG_ATA=y
# CONFIG_ATA is not set

#
# IEEE 1394 (FireWire) support
#
CONFIG_NETDEVICES=y

#
# IEEE 1394 (FireWire) support
#
CONFIG_TUN=y

#
# Distributed Switch Architecture drivers
#
CONFIG_NET_XGENE=y
# CONFIG_NET_XGENE is not set
CONFIG_SMC91X=y
# CONFIG_SMC91X is not set
CONFIG_SMSC911X=y
# CONFIG_SMSC911X is not set

#
# MII PHY device drivers
#
CONFIG_WLAN=y
# CONFIG_WLAN is not set

#
# Userland interfaces
#
CONFIG_INPUT_EVDEV=y

#
# Hardware I/O ports
#
CONFIG_SERIO_SERPORT=y
# CONFIG_SERIO_SERPORT is not set
CONFIG_SERIO_AMBAKMI=y
# CONFIG_SERIO_AMBAKMI is not set

#
# Character devices
#
CONFIG_LEGACY_PTY_COUNT=16

#
# Serial drivers
#
CONFIG_SERIAL_EARLYCON=y
CONFIG_SERIAL_8250=y
# CONFIG_SERIAL_8250 is not set
CONFIG_SERIAL_8250_CONSOLE=y

#
# Non-8250 serial port support
#
CONFIG_SERIAL_AMBA_PL011=y
# CONFIG_SERIAL_AMBA_PL011 is not set
CONFIG_SERIAL_AMBA_PL011_CONSOLE=y
CONFIG_SERIAL_OF_PLATFORM=y
CONFIG_VIRTIO_CONSOLE=y

#
# HSIC/SMUX support for DIAG
#
CONFIG_HW_RANDOM=y
# CONFIG_HW_RANDOM is not set
# CONFIG_HMC_DRV is not set

#
# Other I2C/SMBus bus drivers
#
CONFIG_SPI=y

#
# SPI Master Controller Drivers
#
CONFIG_SPI_PL022=y
# CONFIG_SPI_PL022 is not set

#
# Memory mapped GPIO drivers:
#
CONFIG_GPIO_PL061=y
# CONFIG_GPIO_PL061 is not set
CONFIG_GPIO_XGENE=y

#
# USB GPIO expanders:
#
CONFIG_ZTE_HALL_AVAILABLE=y
CONFIG_HWMON=y
# CONFIG_HWMON is not set

#
# Multifunction device drivers
#
CONFIG_REGULATOR=y
CONFIG_REGULATOR_FIXED_VOLTAGE=y

#
# Frame buffer Devices
#
CONFIG_FB=y
CONFIG_FB_ARMCLCD=y
# CONFIG_FB_ARMCLCD is not set

#
# Frame buffer hardware drivers
#
CONFIG_FRAMEBUFFER_CONSOLE=y
CONFIG_LOGO=y
# CONFIG_LOGO is not set
# CONFIG_LOGO_LINUX_MONO is not set
# CONFIG_LOGO_LINUX_VGA16 is not set

#
# I2C HID support
#
CONFIG_USB=y

#
# USB Host Controller Drivers
#
CONFIG_USB_EHCI_HCD=y
CONFIG_USB_EHCI_HCD_PLATFORM=y
# CONFIG_USB_EHCI_HCD_PLATFORM is not set
CONFIG_USB_ISP1760_HCD=y
# CONFIG_USB_ISP1760_HCD is not set
CONFIG_USB_OHCI_HCD=y
# CONFIG_USB_OHCI_HCD is not set
CONFIG_USB_OHCI_HCD_PLATFORM=y
CONFIG_USB_STORAGE=y

#
# USB Physical Layer drivers
#
CONFIG_USB_ULPI=y
# CONFIG_USB_ULPI is not set

#
# USB Peripheral Controller
#
CONFIG_MMC=y

#
# MMC/SD/SDIO Host Controller Drivers
#
CONFIG_MMC_ARMMMCI=y
# CONFIG_MMC_ARMMMCI is not set
CONFIG_MMC_SDHCI=y
CONFIG_MMC_SDHCI_PLTFM=y
CONFIG_MMC_SPI=y
# CONFIG_MMC_SPI is not set

#
# iptables trigger is under Netfilter config (LED target)
#
CONFIG_RTC_CLASS=y

#
# Platform RTC drivers
#
CONFIG_RTC_DRV_EFI=y
# CONFIG_RTC_DRV_EFI is not set

#
# on-CPU RTC drivers
#
CONFIG_RTC_DRV_XGENE=y
# CONFIG_RTC_DRV_XGENE is not set
CONFIG_VIRTIO_BALLOON=y
CONFIG_VIRTIO_MMIO=y

#
# Clock Source drivers
#
CONFIG_IOMMU_SUPPORT=y
# CONFIG_IOMMU_SUPPORT is not set

#
# PHY Subsystem
#
CONFIG_PHY_XGENE=y
# CONFIG_PHY_XGENE is not set

#
# File systems
#
CONFIG_EXT2_FS=y
CONFIG_EXT3_FS=y
# CONFIG_EXT3_DEFAULTS_TO_ORDERED is not set
CONFIG_EXT3_FS_XATTR=y
# CONFIG_EXT3_FS_XATTR is not set
CONFIG_EXT4_FS=y
CONFIG_FANOTIFY=y
# CONFIG_FANOTIFY is not set
CONFIG_FANOTIFY_ACCESS_PERMISSIONS=y
CONFIG_FUSE_FS=y
CONFIG_CUSE=y
# CONFIG_CUSE is not set

#
# DOS/FAT/NT Filesystems
#
CONFIG_VFAT_FS=y

#
# Pseudo filesystems
#
CONFIG_TMPFS=y
CONFIG_HUGETLBFS=y
# CONFIG_HUGETLBFS is not set
CONFIG_MISC_FILESYSTEMS=y
# CONFIG_MISC_FILESYSTEMS is not set
CONFIG_NFS_FS=y
CONFIG_ROOT_NFS=y
CONFIG_9P_FS=y
CONFIG_NLS_CODEPAGE_437=y
CONFIG_NLS_ISO8859_1=y
CONFIG_VIRTUALIZATION=y
# CONFIG_VIRTUALIZATION is not set
CONFIG_KVM=y

#
# Compile-time checks and compiler options
#
CONFIG_DEBUG_INFO=y
CONFIG_DEBUG_FS=y
CONFIG_MAGIC_SYSRQ=y
CONFIG_DEBUG_KERNEL=y

#
# Debug Lockups and Hangs
#
CONFIG_LOCKUP_DETECTOR=y
# CONFIG_LOCKUP_DETECTOR is not set
CONFIG_SCHED_DEBUG=y
# CONFIG_SCHED_DEBUG is not set

#
# RCU Debugging
#
CONFIG_FTRACE=y
# CONFIG_FTRACE is not set

#
# Qualcomm Technologies, Inc Per File Encryption security device drivers
#
CONFIG_SECURITY=y

#
# Random Number Generation
#
CONFIG_CRYPTO_ANSI_CPRNG=y
# CONFIG_CRYPTO_ANSI_CPRNG is not set
CONFIG_ARM64_CRYPTO=y
CONFIG_CRYPTO_SHA1_ARM64_CE=y
CONFIG_CRYPTO_SHA2_ARM64_CE=y
CONFIG_CRYPTO_GHASH_ARM64_CE=y
CONFIG_CRYPTO_AES_ARM64_CE=y
CONFIG_CRYPTO_AES_ARM64_CE_CCM=y
CONFIG_CRYPTO_AES_ARM64_CE_BLK=y
CONFIG_CRYPTO_AES_ARM64_NEON_BLK=y
```
